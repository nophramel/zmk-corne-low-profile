## config/west.yml
```yaml
manifest:
  remotes:
    - name: zmkfirmware
      url-base: https://github.com/zmkfirmware
    - name: m165437 #remove for standard nice_view shield art
      url-base: https://github.com/M165437 #remove for standard nice_view shield art
  projects:
    - name: zmk
      remote: zmkfirmware
      revision: main
      import: app/west.yml
    - name: nice-view-gem #remove for standard nice_view shield art
      remote: m165437 #remove for standard nice_view shield art
      revision: main #remove for standard nice_view shield art
  self:
    path: config
```
